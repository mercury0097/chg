## main/Kconfig.projbuild
```kconfig
menu "Xiaozhi Assistant"

config OTA_URL
    string "Default OTA URL"
    default "https://api.tenclass.net/xiaozhi/ota/"
    help
        The application will access this URL to check for new firmwares and server address.

choice
    prompt "Flash Assets"
    default FLASH_DEFAULT_ASSETS
    help
        Select the assets to flash.

    config FLASH_NONE_ASSETS
        bool "Do not flash assets"
    config FLASH_DEFAULT_ASSETS
        bool "Flash Default Assets"
    config FLASH_CUSTOM_ASSETS
        bool "Flash Custom Assets"
endchoice

config CUSTOM_ASSETS_FILE
    depends on FLASH_CUSTOM_ASSETS
    string "Custom Assets File"
    default "assets.bin"
    help
        The custom assets file to flash.
        It can be a local file relative to the project directory or a remote url.

choice
    prompt "Default Language"
    default LANGUAGE_ZH_CN
    help
        Select device display language

    config LANGUAGE_ZH_CN
        bool "Chinese"
    config LANGUAGE_ZH_TW
        bool "Chinese Traditional"
    config LANGUAGE_EN_US
        bool "English"
    config LANGUAGE_JA_JP
        bool "Japanese"
    config LANGUAGE_KO_KR
        bool "Korean"
    config LANGUAGE_VI_VN
        bool "Vietnamese"
    config LANGUAGE_TH_TH
        bool "Thai"
    config LANGUAGE_DE_DE
        bool "German"
    config LANGUAGE_FR_FR
        bool "French"
    config LANGUAGE_ES_ES
        bool "Spanish"
    config LANGUAGE_IT_IT
        bool "Italian"
    config LANGUAGE_RU_RU
        bool "Russian"
    config LANGUAGE_AR_SA
        bool "Arabic"
    config LANGUAGE_HI_IN
        bool "Hindi"
    config LANGUAGE_PT_PT
        bool "Portuguese"
    config LANGUAGE_PL_PL
        bool "Polish"
    config LANGUAGE_CS_CZ
        bool "Czech"
    config LANGUAGE_FI_FI
        bool "Finnish"
    config LANGUAGE_TR_TR
        bool "Turkish"
    config LANGUAGE_ID_ID
        bool "Indonesian"
    config LANGUAGE_UK_UA
        bool "Ukrainian"
    config LANGUAGE_RO_RO
        bool "Romanian"
endchoice


choice BOARD_TYPE
    prompt "Board Type"
    default BOARD_TYPE_PALQIQI1
    help
        Board type. 开发板类型 (Only 3 boards: palqiqi1, dog1, palqiqi2)
    config BOARD_TYPE_PALQIQI1
        bool "Palqiqi1 (from xz1)"
        depends on IDF_TARGET_ESP32S3
        select LV_USE_GIF
        select LV_GIF_CACHE_DECODE_DATA
    config BOARD_TYPE_DOG1
        bool "Dog1 (from xz1)"
        depends on IDF_TARGET_ESP32S3
        select LV_USE_GIF
        select LV_GIF_CACHE_DECODE_DATA
    config BOARD_TYPE_PALQIQI2
        bool "Palqiqi2 (from xz2)"
        depends on IDF_TARGET_ESP32S3
        select LV_USE_GIF
        select LV_GIF_CACHE_DECODE_DATA
endchoice

config USE_AUDIO_PROCESSOR
    bool "Use Audio Front End"
    default y
    depends on (IDF_TARGET_ESP32S3 || IDF_TARGET_ESP32P4) && SPIRAM
    help
        Use Audio Front End to improve audio quality

choice WAKE_WORD
    prompt "Wake Word"
    default WAKE_WORD_HILEXIN
    help
        Select the wake word to use

    config WAKE_WORD_HILEXIN
        bool "Hi Lexin (嗨 乐鑫)"
        depends on (IDF_TARGET_ESP32S3 || IDF_TARGET_ESP32P4) && SPIRAM
        help
            Default wake word is "Hi Lexin"

    config USE_CUSTOM_WAKE_WORD
        bool "Custom Wake Word"
        depends on (IDF_TARGET_ESP32S3 || IDF_TARGET_ESP32P4) && SPIRAM
        help
            Use a custom wake word

    config USE_MULTINET_WAKE_WORD
        bool "Multinet model (Custom Wake Word)"
        depends on (IDF_TARGET_ESP32S3 || IDF_TARGET_ESP32P4) && SPIRAM
        help
            Requires ESP32 S3 and PSRAM

endchoice

config CUSTOM_WAKE_WORD
    string "Custom Wake Word"
    depends on USE_CUSTOM_WAKE_WORD
    default "ni hao xiao zhi"
    help
        Custom wake word to use

config CUSTOM_WAKE_WORD_DISPLAY
    string "Custom Wake Word Display"
    depends on USE_CUSTOM_WAKE_WORD
    default "你好小智"
    help
        Display name for custom wake word

endmenu
```
